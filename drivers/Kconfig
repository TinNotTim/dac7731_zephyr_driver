## drivers/dac/dac7731/Kconfig
```kconfig
# Copyright (c) 2024, Tin Chiang.
# SPDX-License-Identifier: Apache-2.0

menuconfig DAC7731
	bool "TI DAC7731 DAC driver"
	default y
	select SPI
	help
	  Enable the driver for the TI DAC7731.

if DAC7731

config DAC7731_INIT_PRIORITY
	int "Init priority"
	default SPI_INIT_PRIORITY
	help
	  TI DAC7731 DAC device driver initialization priority.

endif # DAC7731
```

## dts/bindings/dac/dac7731/ti,dac7731.yaml
```yaml
# Copyright (c) 2024, Tin Chiang
# SPDX-License-Identifier: Apache-2.0

description: |
  Texas Instrucment 16-Bit DACDIGITAL-TO-ANALOG CONVERTER on SPI bus.
  
  Example definition in devicetree:

    dac7731 {
        compatible = "ti,dac7731";
        drdy-gpios = <&gpio0 0 (GPIO_PULL_UP | GPIO_ACTIVE_LOW)>;
    };
  

compatible: "ti,dac7731"

include: [dac-controller.yaml, spi-device.yaml]

properties:
  reset-gpios:
    type: phandle-array
    description: |
      VOUT reset pin.

      Active LOW, depending on the state of RSTSEL, the DAC register is either reset to midscale or min-scale.
  
  ldac-gpios:
    type: phandle-array
    description: |      
      DAC register load control pin.
      
      Rising dege triggered. Data is loaded from the input register to the DAC register.
  
  # Won't include his one. The DAC API only allows passing in 1 value at a time, can't do daisy chain.
  # chain-length:
  #   type: int
  #   default: 1
  #   description: |
  #     The number of DAC7731s in the daisy-chain.

  "#io-channel-cells":
    const: 1

io-channel-cells:
  - output
  
```
